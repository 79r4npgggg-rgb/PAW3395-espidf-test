## main/Kconfig.projbuild
```kconfig
menu "PAW3395 test firmware"

choice PAW3395_TEST_PHASE
    prompt "Test phase"
    default PAW3395_TEST_PHASE_SPI_PROBE
    help
        Begin with the SPI probe.  It performs no sensor register writes and
        verifies the Product_ID and inverse Product_ID values only.

config PAW3395_TEST_PHASE_SPI_PROBE
    bool "1 - SPI product-ID probe only (recommended first flash)"

config PAW3395_TEST_PHASE_FULL_INIT
    bool "2 - Full datasheet initialization and numeric plot output"

config PAW3395_TEST_PHASE_RAW_WEB
    bool "3 - RAW image web viewer (Wi-Fi access point)"

config PAW3395_TEST_PHASE_LOGGER
    bool "4 - Motion logger (microSD CSV + BLE notifications)"
    help
        Performs the full PAW3395 initialization, appends motion samples to a
        FAT-formatted microSD card when present, and advertises a BLE GATT
        service for live Delta_X, Delta_Y, and SQUAL monitoring.  It does not
        start the Wi-Fi RAW viewer.

config PAW3395_TEST_PHASE_WIFI_MONITOR
    bool "5 - Wireless real-time monitor (Wi-Fi SoftAP + WebSocket)"
    select HTTPD_WS_SUPPORT
    help
        Performs the full PAW3395 initialization, samples motion in a
        dedicated task, and streams every sample to a browser over a Wi-Fi
        access point and WebSocket.  microSD logging and BLE are not started
        in this phase so that they cannot disturb the sampling period.

endchoice

config PAW3395_SAMPLE_PERIOD_MS
    int "Plot sample interval (ms)"
    depends on PAW3395_TEST_PHASE_FULL_INIT || PAW3395_TEST_PHASE_LOGGER
    range 1 1000
    default 20
    help
        Interval between motion samples.  In phase 2 this controls numeric
        UART output; in phase 4 it controls microSD rows and BLE notifications.

config PAW3395_RAW_WEB_AP_PASSWORD
    string "RAW web viewer Wi-Fi password"
    default "paw3395raw"
    help
        WPA2 password for the PAW3395-RAW access point. It must contain at
        least eight characters.

config PAW3395_SD_CS_GPIO
    int "microSD SPI chip-select GPIO"
    depends on PAW3395_TEST_PHASE_LOGGER
    range 0 48
    default 3
    help
        XIAO ESP32-S3 D2 / GPIO3 by default.  The microSD card shares the
        PAW3395 SPI clock (GPIO7), MOSI (GPIO9), and MISO (GPIO8), but must
        have its own CS line.  Do not select GPIO1, GPIO2, GPIO7, GPIO8, or
        GPIO9 because those pins are already used by the PAW3395.

config PAW3395_SD_FLUSH_PERIOD_MS
    int "microSD CSV flush interval (ms)"
    depends on PAW3395_TEST_PHASE_LOGGER
    range 100 60000
    default 1000
    help
        Rows are buffered and flushed at this interval.  A shorter interval
        reduces data lost on sudden power removal at the cost of more writes.

config PAW3395_SD_RETRY_PERIOD_MS
    int "microSD remount retry interval (ms)"
    depends on PAW3395_TEST_PHASE_LOGGER
    range 1000 60000
    default 5000
    help
        If no card is present or an SD write fails, continue BLE operation and
        retry mounting at this interval.

config PAW3395_BLE_DEVICE_NAME
    string "BLE advertised device name"
    depends on PAW3395_TEST_PHASE_LOGGER
    default "PAW3395-Logger"
    help
        Name shown by nRF Connect while the logger is advertising.

menu "Wireless monitor (phase 5)"
    depends on PAW3395_TEST_PHASE_WIFI_MONITOR

config PAW3395_MONITOR_AP_SSID
    string "Wi-Fi access point SSID"
    default "PAW3395-MONITOR"
    help
        Network name created by the XIAO ESP32-S3.  1 to 32 characters.

config PAW3395_MONITOR_AP_PASSWORD
    string "Wi-Fi access point password (WPA2)"
    default "paw3395monitor"
    help
        WPA2-PSK password.  It must contain 8 to 63 characters.

config PAW3395_MONITOR_AP_CHANNEL
    int "Wi-Fi channel"
    range 1 13
    default 1

config PAW3395_MONITOR_AP_IP
    string "Access point IPv4 address"
    default "192.168.4.1"
    help
        Address of the monitor page (http://<address>/).  The netmask is
        255.255.255.0 and the DHCP server hands out addresses in that subnet.

config PAW3395_MONITOR_AP_MAX_CLIENTS
    int "Maximum Wi-Fi stations"
    range 1 4
    default 2
    help
        The monitor is designed for one PC.  A second slot lets the same PC
        re-associate before the access point has noticed the old link drop.

config PAW3395_MONITOR_SAMPLE_PERIOD_MS
    int "PAW3395 read period (ms)"
    range 2 1000
    default 10
    help
        Period of the dedicated sampling task (10 ms = 100 Hz).  It must be a
        whole number of FreeRTOS ticks; this project uses CONFIG_FREERTOS_HZ=1000.
        Every read returns the motion the sensor accumulated since the previous
        read, so a slower period loses time resolution but not displacement.

config PAW3395_MONITOR_SAMPLES_PER_PACKET
    int "Samples per WebSocket packet"
    range 1 20
    default 5
    help
        The sender wakes every (period x this value), i.e. every 50 ms by
        default, and sends all samples collected since the previous packet.
        After a stall it catches up with larger packets; samples are never
        thinned out.

config PAW3395_MONITOR_RING_SAMPLES
    int "Sample history kept on the ESP32"
    range 256 8192
    default 2048
    help
        Rounded up to a power of two.  Samples are 16 bytes each in internal
        RAM.  After a Wi-Fi interruption shorter than this history (20.48 s at
        the defaults) the browser resumes without losing samples.

config PAW3395_MONITOR_SYNTHETIC_DATA
    bool "Send generated test data instead of PAW3395 readings"
    default n
    help
        For checking Wi-Fi, WebSocket and the browser without moving the
        sensor.  The page shows TEST DATA and every sample carries the
        synthetic flag.  The PAW3395 identity check still runs at boot.

endmenu

endmenu
```
